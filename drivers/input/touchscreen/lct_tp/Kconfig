## drivers/input/touchscreen/lct_tp/Kconfig
```kconfig
#
# Lct tp driver configuration
#
config TOUCHSCREEN_COMMON
	tristate "Lct tp driver"
	help
	  Say Y here if you have a Lct tp driver

	  If unsure, say N.
```

## drivers/power/supply/battery_secret/Kconfig
```kconfig
config BATT_VERIFY
	tristate "auth battery driver"
	default n
	help
		It needs a onewire physical controller to work.
```
